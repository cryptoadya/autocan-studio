VERSION "democar-0.1.0"

NS_ :

BS_:

BU_: Engine KOMBI

BO_ 512 EngineStatus: 2 Engine
 SG_ EngineRpm : 0|16@1+ (0.25,0) [0|8000] "rpm" KOMBI

CM_ "Original synthetic DemoCar profile. MIT licensed. No OEM mapping.";
CM_ BO_ 512 "Synthetic engine RPM observation; not a physical diagnosis.";

BA_DEF_ BO_ "GenMsgCycleTime" INT 0 65535;
BA_DEF_DEF_ "GenMsgCycleTime" 0;
BA_ "GenMsgCycleTime" BO_ 512 20;
